## Kconfig
```kconfig
# Copyright (c) 2023 ZMK Contributors
# SPDX-License-Identifier: MIT

menuconfig ZMK_DEVICE_DETECTOR
    bool "ZMK设备检测器"
    depends on ADC
    depends on DT_HAS_ZMK_DEVICE_DETECTOR_ENABLED
    help
      启用ZMK设备检测器驱动，用于通过ADC识别和初始化不同类型的设备。

if ZMK_DEVICE_DETECTOR

config ZMK_DEVICE_DETECTOR_INIT_PRIORITY
    int "设备检测器初始化优先级"
    default 90
    help
      设备检测器的设备初始化优先级。

module = ZMK_DEVICE_DETECTOR
module-str = zmk_device_detector
source "subsys/logging/Kconfig.template.log_config"

endif # ZMK_DEVICE_DETECTOR

# PMW3610轨迹球驱动配置
menuconfig PMW3610
    bool "PMW3610轨迹球驱动"
    default n
    depends on SPI
    depends on INPUT
    help
      启用PMW3610轨迹球驱动。

if PMW3610

config PMW3610_INIT_POWER_UP_EXTRA_DELAY_MS
    int "PMW3610初始化额外延迟时间(毫秒)"
    default 0
    help
      在PMW3610初始化过程中添加额外的延迟时间，用于等待外部电源就绪。
      在nice_nano_v2板上，如果出现"Incorrect product id 0xFF (expecting 0x3E)!"错误，
      可以设置为300-1000毫秒。

config PMW3610_INVERT_X
    bool "反转X轴方向"
    default n
    help
      反转X轴的移动方向。

config PMW3610_INVERT_Y
    bool "反转Y轴方向"
    default n
    help
      反转Y轴的移动方向。

config PMW3610_SWAP_XY
    bool "交换X和Y轴"
    default n
    help
      交换X和Y轴的移动方向。

config PMW3610_REPORT_INTERVAL_MIN
    int "最小报告间隔(毫秒)"
    default 10
    help
      两次报告之间的最小间隔时间(毫秒)。

module = PMW3610
module-str = pmw3610
source "subsys/logging/Kconfig.template.log_config"

endif # PMW3610

# 模拟输入(摇杆)驱动配置
menuconfig ANALOG_INPUT
    bool "模拟输入(摇杆)驱动"
    default n
    depends on ADC
    depends on INPUT
    help
      启用模拟输入(摇杆)驱动。

if ANALOG_INPUT

config ANALOG_INPUT_REPORT_INTERVAL_MIN
    int "最小报告间隔(毫秒)"
    default 16
    help
      两次报告之间的最小间隔时间(毫秒)。

config ANALOG_INPUT_LOG_DBG_RAW
    bool "记录原始输入值"
    default n
    help
      在调试日志中记录原始的ADC输入值。

config ANALOG_INPUT_LOG_DBG_REPORT
    bool "记录报告值"
    default n
    help
      在调试日志中记录处理后的报告值。

module = ANALOG_INPUT
module-str = analog_input
source "subsys/logging/Kconfig.template.log_config"

endif # ANALOG_INPUT

# EC11旋钮编码器驱动配置
menuconfig EC11
    bool "EC11旋转编码器支持"
    default y
    depends on GPIO
    help
      启用EC11旋转编码器支持。

if EC11

choice EC11_TRIGGER_MODE
    prompt "触发模式"
    default EC11_TRIGGER_GLOBAL_THREAD
    help
      指定驱动程序使用的触发类型。

config EC11_TRIGGER_NONE
    bool "无触发"

config EC11_TRIGGER_GLOBAL_THREAD
    bool "使用全局线程"
    depends on GPIO
    select EC11_TRIGGER

config EC11_TRIGGER_OWN_THREAD
    bool "使用自己的线程"
    depends on GPIO
    select EC11_TRIGGER

endchoice

config EC11_TRIGGER
    bool

config EC11_THREAD_PRIORITY
    int "线程优先级"
    depends on EC11_TRIGGER_OWN_THREAD
    default 10
    help
      驱动程序用于处理中断的线程优先级。

config EC11_THREAD_STACK_SIZE
    int "线程栈大小"
    depends on EC11_TRIGGER_OWN_THREAD
    default 1024
    help
      驱动程序用于处理中断的线程栈大小。

endif # EC11
```

## Kconfig.module
```kconfig
# Copyright (c) 2023 ZMK Contributors
# SPDX-License-Identifier: MIT

source "$(ZEPHYR_ZMKDEVICEDETECTOR_MODULE_DIR)/zephyr/Kconfig" 
```

## dts/bindings/alps,ec11.yaml
```yaml
description: EC11旋钮增量编码器

compatible: "alps,ec11"

include: base.yaml

properties:
  a-gpios:
    type: phandle-array
    required: true
    description: A相信号GPIO引脚

  b-gpios:
    type: phandle-array
    required: true
    description: B相信号GPIO引脚

  resolution:
    type: int
    default: 1
    description: 每个脉冲的分辨率

  steps:
    type: int
    default: 24
    description: 编码器每旋转一圈的步数 
```

## dts/bindings/pixart,pmw3610.yaml
```yaml
description: PMW3610轨迹球传感器

compatible: "pixart,pmw3610"

include: [spi-device.yaml, input.yaml]

properties:
  irq-gpios:
    type: phandle-array
    required: true
    description: 中断GPIO引脚，用于数据就绪信号

  cpi:
    type: int
    default: 400
    description: 传感器分辨率(CPI)设置

  evt-type:
    type: int
    default: 0x02 # INPUT_EV_REL
    description: 输入事件类型，通常为相对坐标移动(INPUT_EV_REL)

  x-input-code:
    type: int
    default: 0x00 # INPUT_REL_X
    description: X轴输入代码，通常为REL_X

  y-input-code:
    type: int
    default: 0x01 # INPUT_REL_Y 
    description: Y轴输入代码，通常为REL_Y

  force-awake:
    type: boolean
    description: 当ZMK活动状态为ACTIVE时保持传感器唤醒，ZMK进入空闲/睡眠模式后恢复正常省电模式 
```

## dts/bindings/zmk,analog-input.yaml
```yaml
description: ZMK模拟输入(摇杆)驱动

compatible: "zmk,analog-input"

include: base.yaml

properties:
  sampling-hz:
    type: int
    default: 100
    description: 采样频率(Hz)

child-binding:
  description: 轴通道配置

  properties:
    io-channels:
      type: phandle-array
      required: true
      description: ADC通道

    mv-mid:
      type: int
      default: 1650
      description: 中点电压(毫伏)
    
    mv-min-max:
      type: int
      default: 1600
      description: 最小/最大偏移电压(毫伏)
    
    mv-deadzone:
      type: int
      default: 10
      description: 中点死区宽度(毫伏)
    
    scale-multiplier:
      type: int
      default: 1
      description: 缩放乘数
    
    scale-divisor:
      type: int
      default: 1
      description: 缩放除数
    
    invert:
      type: boolean
      description: 反转输出
    
    report-on-change-only:
      type: boolean
      description: 仅在值变化时报告
    
    evt-type:
      type: int
      required: true
      description: 输入事件类型
    
    input-code:
      type: int
      required: true
      description: 输入事件代码 
```

## dts/bindings/zmk,device-detector.yaml
```yaml
description: ZMK设备检测器，通过ADC识别不同设备

compatible: "zmk,device-detector"

include: base.yaml

properties:
  label:
    type: string
    description: 人类可读的设备名称

  adc:
    type: phandle
    description: ADC设备的句柄
    required: true

  adc-thresholds:
    type: array
    description: 各设备类型对应的ADC阈值(毫伏)，按设备类型顺序排列
    required: true

  adc-threshold-tolerance:
    type: int
    description: ADC阈值的容差(毫伏)，用于处理ADC读数的波动
    default: 50

  poll-interval-ms:
    type: int
    description: 设备检测的轮询间隔(毫秒)
    default: 1000 
```

## dts/bindings/zmk,module-detector.yaml
```yaml
description: ZMK Hot Swappable Module Detector

compatible: "zmk,module-detector"

include: base.yaml

properties:
  sampling-hz:
    type: int
    default: 2
    description: Sampling frequency in Hz

  io-channels:
    type: phandle-array
    required: true
    description: ADC channel for module detection

  detection-delay-ms:
    type: int
    default: 50
    description: Debounce delay for module detection in milliseconds

  voltage-ranges:
    type: array
    description: |
      Voltage ranges for different module types in millivolts.
      Format: [module1_min, module1_max, module2_min, module2_max, ...]
    default: [500, 1000, 1500, 2000, 2500, 3000] 
```

## zephyr/Kconfig
```kconfig
# Copyright (c) 2023 ZMK Contributors
# SPDX-License-Identifier: MIT

# ZMK设备检测器
menuconfig ZMK_DEVICE_DETECTOR
    bool "ZMK设备检测器"
    default y
    depends on ADC
    help
      启用ZMK设备检测器，用于自动检测和初始化输入设备。

if ZMK_DEVICE_DETECTOR

config ZMK_DEVICE_DETECTOR_LOG_LEVEL
    int "日志级别"
    default 3
    range 0 4
    help
      设备检测器日志级别。
      0: 关闭, 1: 错误, 2: 警告, 3: 信息, 4: 调试

config ZMK_DEVICE_DETECTOR_INIT_PRIORITY
    int "初始化优先级"
    default 90
    help
      设备检测器初始化优先级。

endif # ZMK_DEVICE_DETECTOR

# EC11旋钮编码器驱动
menuconfig EC11
    bool "EC11 增量编码器传感器"
    default y
    depends on DT_HAS_ALPS_EC11_ENABLED
    depends on GPIO
    help
      启用EC11增量编码器传感器驱动。

if EC11

choice EC11_TRIGGER_MODE
    prompt "触发模式"
    default EC11_TRIGGER_NONE
    help
      指定驱动要使用的触发类型。

config EC11_TRIGGER_NONE
    bool "无触发"

config EC11_TRIGGER_GLOBAL_THREAD
    bool "使用全局线程"
    depends on GPIO
    select EC11_TRIGGER

config EC11_TRIGGER_OWN_THREAD
    bool "使用独立线程"
    depends on GPIO
    select EC11_TRIGGER

endchoice

config EC11_TRIGGER
    bool

config EC11_THREAD_PRIORITY
    int "线程优先级"
    depends on EC11_TRIGGER_OWN_THREAD
    default 10
    help
      驱动用于处理中断的线程优先级。

config EC11_THREAD_STACK_SIZE
    int "线程栈大小"
    depends on EC11_TRIGGER_OWN_THREAD
    default 1024
    help
      驱动用于处理中断的线程栈大小。

endif # EC11

# PMW3610轨迹球驱动
menuconfig PMW3610
    bool "PMW3610轨迹球传感器"
    default y
    depends on DT_HAS_PIXART_PMW3610_ENABLED
    depends on SPI
    depends on GPIO
    help
      启用PMW3610轨迹球传感器驱动。

if PMW3610

config PMW3610_LOG_LEVEL
    int "日志级别"
    default 3
    range 0 4
    help
      PMW3610日志级别。
      0: 关闭, 1: 错误, 2: 警告, 3: 信息, 4: 调试

config PMW3610_INIT_POWER_UP_EXTRA_DELAY_MS
    int "额外初始化延迟(毫秒)"
    default 10
    help
      初始化传感器时等待电源稳定的额外延迟时间(毫秒)。

config PMW3610_REPORT_INTERVAL_MIN
    int "最小报告间隔(毫秒)"
    default 5
    help
      两次输入事件报告之间的最小时间间隔(毫秒)。

config PMW3610_SWAP_XY
    bool "交换X和Y轴"
    default n
    help
      交换X和Y轴的输出。

config PMW3610_INVERT_X
    bool "反转X轴"
    default n
    help
      反转X轴的输出方向。

config PMW3610_INVERT_Y
    bool "反转Y轴"
    default n
    help
      反转Y轴的输出方向。

endif # PMW3610

# 模拟输入(摇杆)驱动
menuconfig ANALOG_INPUT
    bool "模拟输入(摇杆)驱动"
    default y
    depends on DT_HAS_ZMK_ANALOG_INPUT_ENABLED
    depends on ADC
    help
      启用模拟输入设备驱动(用于摇杆等)。

if ANALOG_INPUT

config ANALOG_INPUT_LOG_LEVEL
    int "日志级别"
    default 3
    range 0 4
    help
      模拟输入日志级别。
      0: 关闭, 1: 错误, 2: 警告, 3: 信息, 4: 调试

config ANALOG_INPUT_LOG_DBG_RAW
    bool "记录原始ADC值"
    default n
    help
      在调试日志中输出原始ADC读数。

config ANALOG_INPUT_LOG_DBG_REPORT
    bool "记录报告值"
    default n
    help
      在调试日志中输出报告的输入值。

config ANALOG_INPUT_REPORT_INTERVAL_MIN
    int "最小报告间隔(毫秒)"
    default 5
    help
      两次输入事件报告之间的最小时间间隔(毫秒)。

endif # ANALOG_INPUT 
```
