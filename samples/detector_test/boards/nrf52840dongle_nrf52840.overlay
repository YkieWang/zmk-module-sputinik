/*
 * Copyright (c) 2023 The ZMK Contributors
 *
 * SPDX-License-Identifier: MIT
 */

#include <dt-bindings/zmk/matrix_transform.h>

&adc {
    status = "okay";
};

/ {
    device_detector {
        compatible = "zmk,device-detector";
        status = "okay";
        io-channels = <&adc 2>;  // 使用ADC通道2 (AIN2)
        sampling-hz = <5>;       // 每秒采样5次
        detection-delay-ms = <100>; // 识别延迟（去抖动）
        voltage-ranges = <500 1000 1000 1500 1500 2000 2000 2500 2500 3000>; // 电压范围定义
    };
}; 