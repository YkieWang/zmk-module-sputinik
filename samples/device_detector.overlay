/*
 * 热插拔设备检测器配置示例
 */

#include <dt-bindings/zmk/matrix_transform.h>

&adc {
    status = "okay";
};

/ {
    device_detector {
        compatible = "zmk,device-detector";
        status = "okay";
        io-channels = <&adc 2>;  // 使用ADC通道2
        sampling-hz = <2>;       // 每秒采样2次
        detection-delay-ms = <50>; // 识别延迟（去抖动）
        
        /* 
         * 电压范围定义（毫伏）：
         * [旋钮_最小, 旋钮_最大, 摇杆_最小, 摇杆_最大, 轨迹球_最小, 轨迹球_最大, 滑块_最小, 滑块_最大, 其他_最小, 其他_最大]
         */
        voltage-ranges = <500 1000 1000 1500 1500 2000 2000 2500 2500 3000>;
    };
}; 